## zmk-input-processor-key/Kconfig
```kconfig
config ZMK_INPUT_PROCESSOR_KEY
    bool "ZMK Input Processor: XY-to-Arrow-Key conversion"
    default y if DT_HAS_ZMK_INPUT_PROCESSOR_KEY_ENABLED
    depends on ZMK_POINTING
    help
      Enables the zmk,input-processor-key driver which accumulates
      trackball/mouse XY movement and converts it into discrete
      keyboard arrow-key HID reports.  Mirrors the behaviour of
      TrackballArrows.ahk: movement past a threshold fires one key
      press/release cycle; a burst cap limits events per poll cycle.

config ZMK_INPUT_PROCESSOR_ACCEL
    bool "ZMK Input Processor: Velocity-based acceleration"
    default y if DT_HAS_ZMK_INPUT_PROCESSOR_ACCEL_ENABLED
    depends on ZMK_POINTING
    help
      Enables the zmk,input-processor-accel driver which scales XY
      motion events based on trackball velocity.  Gentle rolls pass
      through unchanged; fast rolls are amplified up to a configurable
      gain.  Useful for scroll acceleration.
```

## zmk-input-processor-key/dts/bindings/input_processors/zmk,input-processor-accel.yaml
```yaml
# Copyright (c) 2026 ergohaven-zmk-config contributors
# SPDX-License-Identifier: MIT

description: |
  Input processor that applies velocity-based acceleration to XY motion events.

  Tracks inter-event timing per axis. When the trackball is rolled faster,
  event values are scaled up (multiplied). Gentle rolls pass through unchanged.

  Acceleration model (integer math, no floats):
    speed     = |delta| × 1000 / dt_ms
    excess    = speed - ref_speed            (zero if below threshold)
    multiplier = 256 + excess × (gain - 256) / ref_speed
    output    = value × multiplier / 256     (clamped to [1× .. gain/256×])

  Designed to sit before a scaler or scroll-mapper in the pipeline:

    scroller {
        layers = <1>;
        input-processors =
            <&zip_xy_transform INPUT_TRANSFORM_Y_INVERT>,
            <&zip_scroll_accel>,
            <&zip_xy_scaler 1 32>,
            <&zip_xy_to_scroll_mapper &zip_scroll_snap>;
    };

compatible: "zmk,input-processor-accel"

properties:
  "#input-processor-cells":
    type: int
    required: true
    const: 0
    description: No phandle-cell parameters.

  gain:
    type: int
    required: true
    description: |
      Maximum multiplier expressed in 1/256 units.
        256 = 1.0× (no acceleration at all)
        384 = 1.5× max
        512 = 2.0× max
        768 = 3.0× max
      The multiplier ramps linearly from 1× (at ref-speed) to gain/256
      (at 2× ref-speed), then clamps.

  ref-speed:
    type: int
    required: true
    description: |
      Speed threshold below which no acceleration is applied.
      Speed is measured as |delta| × 1000 / dt_ms (units per second).
      Typical value for a 32mm trackball: 30–100.
      Lower values → acceleration kicks in sooner.

  track-remainders:
    type: boolean
    description: |
      Placeholder for ZMK input_listener macro compatibility.
```

## zmk-input-processor-key/dts/bindings/input_processors/zmk,input-processor-key.yaml
```yaml
# Copyright (c) 2026 ergohaven-zmk-config contributors
# SPDX-License-Identifier: MIT

description: |
  Input processor that converts trackball/mouse XY motion deltas into
  discrete keyboard arrow-key HID press+release events.

  Replicates TrackballArrows.ahk v4.0 entirely in ZMK firmware:
    - Accumulates scaled XY deltas (dead-zone implicit in threshold)
    - When |accumulator| >= threshold → fires N press+release cycles
    - Burst cap limits maximum presses per sensor poll event
    - Original REL_X / REL_Y events are suppressed (cursor stays still)

  Typical pipeline (layer 2 = arrows mode):

    arrows {
        layers = <2>;
        input-processors =
            <&zip_xy_transform INPUT_TRANSFORM_DOMINANT_AXIS>,
            <&zip_xy_scaler 1 20>,
            <&zip_arrows>;
    };

  Where zip_arrows is defined in the root devicetree node:

    zip_arrows: zip_arrows {
        compatible = "zmk,input-processor-key";
        #input-processor-cells = <0>;
        x-key-negative = <LEFT>;    // ZMK HID usage 0x50
        x-key-positive = <RIGHT>;   // ZMK HID usage 0x4F
        x-threshold    = <5>;
        y-key-negative = <UP>;      // ZMK HID usage 0x52
        y-key-positive = <DOWN>;    // ZMK HID usage 0x51
        y-threshold    = <5>;
        max-report     = <4>;
    };

compatible: "zmk,input-processor-key"

properties:
  "#input-processor-cells":
    type: int
    required: true
    const: 0
    description: |
      No phandle-cell parameters — all configuration lives in node
      properties below.

  x-key-negative:
    type: int
    required: true
    description: |
      ZMK HID keyboard usage ID for negative X movement (moving left).
      Use ZMK key constants from <dt-bindings/zmk/keys.h>, e.g. LEFT (0x50).

  x-key-positive:
    type: int
    required: true
    description: |
      ZMK HID keyboard usage ID for positive X movement (moving right).
      e.g. RIGHT (0x4F).

  x-threshold:
    type: int
    required: true
    description: |
      Minimum absolute accumulated X delta before one key press fires.
      Combined with an upstream zip_xy_scaler to represent the effective
      sensitivity (threshold × scaler_denominator = raw CPI units needed).

  y-key-negative:
    type: int
    required: true
    description: |
      ZMK HID keyboard usage ID for negative Y movement (moving up).
      e.g. UP (0x52).

  y-key-positive:
    type: int
    required: true
    description: |
      ZMK HID keyboard usage ID for positive Y movement (moving down).
      e.g. DOWN (0x51).

  y-threshold:
    type: int
    required: true
    description: |
      Minimum absolute accumulated Y delta before one key press fires.

  max-report:
    type: int
    default: 4
    description: |
      Maximum number of key presses emitted per sensor event.
      Prevents event-queue buildup during fast motion — mirrors
      AHK's MAX_BURST = 4 config constant.

  track-remainders:
    type: boolean
    description: |
      Whether the input listener should maintain per-axis
      remainder accumulators for this processor.  Not needed
      for this driver (it keeps its own accumulators) but the
      property must exist in the binding so ZMK's input_listener
      macros can query it.
```
